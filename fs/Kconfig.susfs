## fs/Kconfig.susfs
```kconfig
# SPDX-License-Identifier: GPL-2.0-only
menu "KernelSU - SUSFS"

config KSU_SUSFS
	bool "SUSFS Support"
	default y
	help
	  Enable SUSFS (Suspicious File System) kernel support.

config KSU_SUSFS_SUS_PATH
	bool "Enable to hide suspicious path"
	depends on KSU_SUSFS
	default y

config KSU_SUSFS_SUS_MOUNT
	bool "Enable to hide suspicious mounts"
	depends on KSU_SUSFS
	default y

config KSU_SUSFS_SUS_KSTAT
	bool "Enable to spoof suspicious kstat"
	depends on KSU_SUSFS
	default y

config KSU_SUSFS_SPOOF_UNAME
	bool "Enable to spoof uname"
	depends on KSU_SUSFS
	default y

config KSU_SUSFS_ENABLE_LOG
	bool "Enable logging susfs log to kernel"
	depends on KSU_SUSFS
	default y

config KSU_SUSFS_HIDE_KSU_SUSFS_SYMBOLS
	bool "Enable to automatically hide ksu and susfs symbols from /proc/kallsyms"
	depends on KSU_SUSFS
	default y

config KSU_SUSFS_SPOOF_CMDLINE_OR_BOOTCONFIG
	bool "Enable to spoof /proc/bootconfig (gki) or /proc/cmdline (non-gki)"
	depends on KSU_SUSFS
	default y

config KSU_SUSFS_OPEN_REDIRECT
	bool "Enable to redirect a path to be opened with another path (experimental)"
	depends on KSU_SUSFS
	default y

config KSU_SUSFS_SUS_MAP
	bool "Enable hiding some mmapped real files from different proc maps interfaces"
	depends on KSU_SUSFS
	default y

config KSU_SUSFS_AUTO_ADD_SUS_BIND_MOUNT
	bool "Enable auto add sus bind mount"
	depends on KSU_SUSFS
	default y

config KSU_SUSFS_AUTO_ADD_SUS_KSTAT
	bool "Enable auto add sus kstat"
	depends on KSU_SUSFS
	default y

config KSU_SUSFS_ENABLE_AVC_LOG_SPOOFING
	bool "Enable AVC log spoofing"
	depends on KSU_SUSFS
	default y

config KSU_SUSFS_TRY_UMOUNT
	bool "Enable try umount"
	depends on KSU_SUSFS
	default y

endmenu
```
